## config/boards/shields/totem/Kconfig.defconfig
```kconfig
# Copyright (c) 2022 The ZMK Contributors
# SPDX-License-Identifier: MIT

# --- Dongle (USB central) ---
if SHIELD_TOTEM_DONGLE

config ZMK_KEYBOARD_NAME
    default "TOTEM"

config ZMK_SPLIT
    default y

config ZMK_SPLIT_ROLE_CENTRAL
    default y

# Two BLE peripherals: left + right halves
config ZMK_SPLIT_BLE_CENTRAL_PERIPHERALS
    default 2

# n_peripherals + 1 for headroom
config BT_MAX_CONN
    default 3

config BT_MAX_PAIRED
    default 3

endif

# --- Halves (BLE peripherals) ---
if SHIELD_TOTEM_LEFT || SHIELD_TOTEM_RIGHT

config ZMK_SPLIT
    default y

endif
```
